## dts/bindings/behaviors/zmk,behavior-accel-cycle.yaml
```yaml
description: |
  トラックボールの加速度プリセットを、押すたびに OFF -> 弱 -> 中 -> 強 -> OFF... と
  循環させる。電源を入れ直すと .conf のデフォルト（強）に戻る。

compatible: "zmk,behavior-accel-cycle"

include: zero_param.yaml
```

## dts/bindings/behaviors/zmk,behavior-cpi-adjust.yaml
```yaml
description: |
  トラックボールのカーソルCPIを、押した瞬間に delta だけ増減させる（200〜3200にクランプ）。
  電源を入れ直すと .conf のデフォルト値に戻る。

compatible: "zmk,behavior-cpi-adjust"

include: one_param.yaml
```
